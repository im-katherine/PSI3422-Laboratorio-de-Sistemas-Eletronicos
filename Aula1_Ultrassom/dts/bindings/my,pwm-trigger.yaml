## Aula1_Ultrassom/dts/bindings/my,pwm-trigger.yaml
```yaml
description: Custom PWM trigger node

compatible: "my,pwm-trigger"

include: base.yaml

properties:
  pwms:
    type: phandle-array
    required: true
```
